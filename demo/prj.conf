## CMakeLists.txt
```
# Copyright (c) 2024 Marthinus Scholtz
# SPDX-License-Identifier: Apache-2.0


cmake_minimum_required(VERSION 3.20.0)


list(APPEND ZEPHYR_EXTRA_MODULES ${CMAKE_CURRENT_SOURCE_DIR}/../zstd)

find_package(Zephyr REQUIRED HINTS $ENV{ZEPHYR_BASE})
project(demo)


target_sources(app PRIVATE
    src/main.c
)

# Build and bring in the rust package as an "external project".
include(ExternalProject)

set(rust_app_src_dir ${PROJECT_SOURCE_DIR})
set(rust_app_build_dir ${rust_app_src_dir})
ExternalProject_Add(
        rust_app_project
        PREFIX ${standlone_build_dir}
        SOURCE_DIR ${rust_app_src_dir}
        BINARY_DIR ${rust_app_src_dir}
        CONFIGURE_COMMAND ""
        # For the build to always be run, so that changes in the Rust
        # code are detected.
        BUILD_ALWAYS TRUE
        BUILD_COMMAND "cargo" "rustc" "--target" "x86_64-unknown-none" "--release" "--" "--emit" "asm"
        INSTALL_COMMAND ""
        BUILD_BYPRODUCTS
          ${rust_app_build_dir}/target/x86_64-unknown-none/release/libdemo.a
        # needed to produce colored output
        USES_TERMINAL_BUILD true
	DEPENDS zephyr_interface
)

add_library(rust_app_lib STATIC IMPORTED GLOBAL)

add_dependencies(
        rust_app_lib
        rust_app_project
)

set_target_properties(rust_app_lib PROPERTIES IMPORTED_LOCATION
  ${rust_app_build_dir}/target/x86_64-unknown-none/release/libdemo.a)

# Add our application, along with -lgcc
target_link_libraries(app PUBLIC rust_app_lib)
```

## west.yml
```
manifest:
  projects:
  - name: zephyr
    revision: v3.7.0
    url: https://github.com/zephyrproject-rtos/zephyr
    west-commands: scripts/west-commands.yml
  self:
    path: demo
```

## prj.conf
```kconfig
CONFIG_RUST=y

CONFIG_LOG=y

CONFIG_INIT_STACKS=y
CONFIG_THREAD_STACK_INFO=y
CONFIG_MAX_THREAD_BYTES=5
CONFIG_DYNAMIC_THREAD=y
CONFIG_DYNAMIC_THREAD_POOL_SIZE=2
CONFIG_DYNAMIC_THREAD_ALLOC=y
CONFIG_HEAP_MEM_POOL_SIZE=16384


CONFIG_NETWORKING=y
CONFIG_NET_UDP=y
CONFIG_NET_TCP=y
CONFIG_NET_IPV4=y
CONFIG_NET_SOCKETS=y
#CONFIG_NET_CONNECTION_MANAGER=y
#CONFIG_POSIX_API=y


CONFIG_NET_LOG=y
CONFIG_ETH_NATIVE_POSIX=n
CONFIG_NET_DRIVERS=y
CONFIG_NET_SOCKETS_OFFLOAD=y
CONFIG_NET_NATIVE_OFFLOADED_SOCKETS=y

# IPv6 DAD requires lower level network interface access, below exposed socket-level access
CONFIG_NET_IPV6_DAD=n
```

## src/main.c
```c
#include <stdio.h>
#include "../../zstd/include/logger.h"
#include "rustlib.h"

LOG_MODULE_REGISTER(demo, 4);

NEW_LOG_INSTANCE(demo, rust, 4);
NEW_LOG_INSTANCE(demo, c, 4);

int main(void)
{
    LOG_INST_INF(c.log, "entering Rust code.....");

    int sum = rust_test(1, 2);

    LOG_INST_INF(c.log, "rust_add(1, 2) = %d", sum);

	return 0;
}
```

## src/rustlib.h
```c
#pragma once

int rust_test(int a, int b);
```
